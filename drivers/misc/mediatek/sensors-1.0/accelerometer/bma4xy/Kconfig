## drivers/misc/mediatek/sensors-1.0/accelerometer/bma4xy/Kconfig
```kconfig
#
# Makefile for Bosch sensors driver.
#

config SENSORS_BMA4XY
	tristate "BMA4XY acceleration sensor support"
	depends on I2C
	help
	  If you say yes here, you get support for Bosch Sensortec's
	  acceleration sensors BMA4XY.
```

## drivers/misc/mediatek/sensors-1.0/heart_rate_sensor/pah8001/Kconfig
```kconfig
config MTK_PAH8001
	bool "Enable heartrate sensor for PixArt PAH8001"
	depends on I2C
	default n
	help
	  Enable heartrate sensor for PixArt PAH8001
```

## drivers/misc/mediatek/sensors-1.0/tilt_detector_sensor/Kconfig
```kconfig
config CUSTOM_KERNEL_TILT_DETECTOR_SENSOR
	bool "CUSTOM_KERNEL_TILT_DETECTOR_SENSOR"
	help
	  Kernel space tilt detector sensor driver.
source "drivers/misc/mediatek/sensors-1.0/tilt_detector_sensor/tiltdetecthub/Kconfig"
```
